## meta-my-layer/meta-wic/conf/layer.conf
```bitbake
# meta-my-layer/meta-wic/conf/layer.conf
# Minimal layer.conf for the meta-wic layer

BBPATH .= ":${LAYERDIR}"
BBFILES += "${LAYERDIR}/recipes-*/*/*.bb ${LAYERDIR}/recipes-*/*/*.bbappend"

BBFILE_COLLECTIONS += "meta-wic"
BBFILE_PATTERN_meta-wic := "${LAYERDIR}/.*"
BBFILE_PRIORITY_meta-wic = "6"

LAYERDEPENDS ?= ""
# Indiquer la compatibilité avec le layer poky/meta
LAYERSERIES_COMPAT_meta-wic = "scarthgap"
# Tell image recipes to use our custom .wks by default (overrideable)
WKS_FILE = "custom-qemuarm64.wks"
# wic might need kernel available at image build time
WKS_FILE_DEPENDS = "virtual/kernel"
```
