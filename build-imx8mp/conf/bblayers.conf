## build-imx8mp/conf/bblayers.conf
```bitbake
BBLAYERS ?= " \
    /workdir/meta-freescale \
    /workdir/meta-freescale-3rdparty \
    /workdir/meta-freescale-distro \
    /workdir/meta-mender-community/meta-mender-nxp \
    /workdir/meta-mender/meta-mender-core \
    /workdir/meta-openembedded/meta-filesystems \
    /workdir/meta-openembedded/meta-gnome \
    /workdir/meta-openembedded/meta-multimedia \
    /workdir/meta-openembedded/meta-networking \
    /workdir/meta-openembedded/meta-oe \
    /workdir/meta-openembedded/meta-python \
    /workdir/meta-qt5 \
    /workdir/meta-qt5-extra \
    /workdir/meta-security/meta-tpm \
    /workdir/meta-toradex-bsp-common \
    /workdir/meta-toradex-demos \
    /workdir/meta-toradex-distro \
    /workdir/meta-toradex-nxp \
    /workdir/poky/meta \
    /workdir/poky/meta-poky \
    /workdir/poky/meta-yocto-bsp"
BBPATH ?= "${TOPDIR}"
BBFILES ??= ""
```

## build-imx8mp/conf/local.conf
```bitbake
# my-config

INHERIT += "rm_work"
PACKAGE_CLASSES ?= "package_ipk"
INIT_MANAGER = "systemd"
IMAGE_FSTYPES += "ext4"
EXTRA_IMAGE_FEATURES = "debug-tweaks"
IMAGE_INSTALL:remove = "packagegroup-basic"
IMAGE_INSTALL:append = " packagegroup-core-ssh-openssh openssh-sftp-server vim"
DISTRO_FEATURES:remove = "ssh-server-dropbear"
IMAGE_INSTALL:remove = "dropbear"
ACCEPT_FSL_EULA = "1"

# Pas de Mender ici, kernel + dtb natifs pour imx8mp-evk QEMU
KERNEL_DEVICETREE = "imx8mp-evk.dtb"


# IMAGE_CLASSES += "image_type_mender_tezi"
# IMAGE_FSTYPES:append = " mender_tezi"
# IMAGE_FSTYPES:remove = " teziimg"

IMAGE_FSTYPES += "wic"
# WKS_FILE = "imx-uboot.wks"
# UBOOT_BINARY = "u-boot-sd-2024.07-r0.bin"


# * ================================================================
# * Mender configuration (meta-mender-core)
# * ================================================================

INHERIT += "mender-full"

# Name of the Mender artifact
MENDER_ARTIFACT_NAME = "release-test"

# # Mender server URL and tenant token
# # MENDER_SERVER_URL = "https://eu.hosted.mender.io"
# # MENDER_SERVER_URL = ""
# # MENDER_TENANT_TOKEN = "AVi5j0YkJYNeYRamqwzY2r9WRz3sJo5nbGDGaE0uXtQ"

# Device type
MENDER_DEVICE_TYPE = "imx8mp-verdin"

# Storage device and partition layout
MENDER_STORAGE_DEVICE = "/dev/mmcblk0"
MENDER_STORAGE_TOTAL_SIZE_MB = "4096"
MENDER_BOOT_PART_SIZE_MB = "100"
MENDER_DATA_PART_SIZE_MB = "128"
MENDER_FEATURES_ENABLE:append = " mender-image-gpt mender-uboot"
MENDER_FEATURES_DISABLE:append = " mender-grub mender-image-uefi"
# ! Enable automatic U-Boot configuration for partitions
MENDER_UBOOT_AUTO_CONFIGURE = "1"

# # Polling intervals (empty = default)
# # MENDER_UPDATE_POLL_INTERVAL_SECONDS = ""
# # MENDER_INVENTORY_POLL_INTERVAL_SECONDS = ""
# # MENDER_RETRY_POLL_INTERVAL_SECONDS = ""


IMAGE_INSTALL:append = " mender-artifact-info"
IMAGE_BOOT_FILES += "boot.scr-verdin-imx8mp"

# UBOOT_CONFIG ??= "sd"
# UBOOT_ENV ?= "u-boot-initial-env"

MACHINE ??= "verdin-imx8mp"
DISTRO ??= "tdx-xwayland"
BBMULTICONFIG ?= ""
```

## meta-imx8mp-rega/meta-binutils/conf/layer.conf
```bitbake
# ==============================================================================
# Project : Secure Embedded Linux OTA System (REGA)
# File    : layer.conf
# Author  : Stanley Selvaratnam
# Target  : Toradex Verdin iMX8MP
# Yocto   : Custom layer / recipe
# Email   : stanley.selvaratnam@gmail.com
# ==============================================================================

# Add the conf and classes directories to BBPATH
BBPATH .= ":${LAYERDIR}"
BBFILES += "${LAYERDIR}/recipes-*/*/*.bb ${LAYERDIR}/recipes-*/*/*.bbappend"

# Layer priority for this custom layer
LAYER_PRIORITY_meta-binutils = "6"

# Optional: additional layer-specific variables
LAYERVERSION_meta-binutils = "1"
```

## meta-imx8mp-rega/meta-connectivity/conf/layer.conf
```bitbake
# ==============================================================================
# Project : Secure Embedded Linux OTA System (REGA)
# File    : layer.conf
# Author  : Stanley Selvaratnam
# Target  : Toradex Verdin iMX8MP
# Yocto   : Custom layer / recipe
# Email   : stanley.selvaratnam@gmail.com
# ==============================================================================

# meta-connectivity configuration

BBPATH .= ":${LAYERDIR}"

LCONF_VERSION = "7"

# Yocto series compatibility
LAYERSERIES_COMPAT_meta-connectivity = "scarthgap kirkstone poky"

# Layer collection declaration
BBFILE_COLLECTIONS += "meta-connectivity"
BBFILE_PATTERN_meta-connectivity = "^${LAYERDIR}/"
BBFILE_PRIORITY_meta-connectivity = "9"

# Search for recipes and bbappends in this layer
BBFILES += "${LAYERDIR}/recipes-*/*/*.bb \
            ${LAYERDIR}/recipes-*/*/*.bbappend"

# Ensure Yocto finds associated patch or conf files
FILESEXTRAPATHS:prepend := "${LAYERDIR}/recipes-kernel/linux-firmware-rpidistro/files:"
```

## meta-imx8mp-rega/meta-crypto/conf/layer.conf
```bitbake
# ==============================================================================
# Project : Secure Embedded Linux OTA System (REGA)
# File    : layer.conf
# Author  : Stanley Selvaratnam
# Target  : Toradex Verdin iMX8MP
# Yocto   : Custom layer / recipe
# Email   : stanley.selvaratnam@gmail.com
# ==============================================================================

# Declare this layer
BBPATH .= ":${LAYERDIR}"

BBFILES += "${LAYERDIR}/recipes-*/*/*.bb \
            ${LAYERDIR}/recipes-*/*/*.bbappend"

BBFILE_COLLECTIONS += "meta-crypto"
BBFILE_PATTERN_meta-crypto = "^${LAYERDIR}/"
BBFILE_PRIORITY_meta-crypto = "10"

LAYERSERIES_COMPAT_meta-crypto = "scarthgap"
LAYERDEPENDS_meta-crypto = "core mender"
```

## meta-imx8mp-rega/meta-custom-security/conf/layer.conf
```bitbake
# ==============================================================================
# Project : Secure Embedded Linux OTA System (REGA)
# File    : layer.conf
# Author  : Stanley Selvaratnam
# Target  : Toradex Verdin iMX8MP
# Yocto   : Custom layer / recipe
# Email   : stanley.selvaratnam@gmail.com
# ==============================================================================

# We have a conf and classes directory, add to BBPATH
BBPATH .= ":${LAYERDIR}"

# We have recipes-* directories, add to BBFILES
BBFILES += "${LAYERDIR}/recipes-*/*/*.bb \
            ${LAYERDIR}/recipes-*/*/*.bbappend"

BBFILE_COLLECTIONS += "meta-custom-security"
BBFILE_PATTERN_meta-custom-security = "^${LAYERDIR}/"
BBFILE_PRIORITY_meta-custom-security = "20"

# Adaptez la compatibilité selon votre version de Yocto (kirkstone, scarthgap, etc.)
LAYERDEPENDS_meta-custom-security = "core"
LAYERSERIES_COMPAT_meta-custom-security = "kirkstone scarthgap mickledore"
```

## meta-imx8mp-rega/meta-custom-u-boot/conf/layer.conf
```bitbake
# ==============================================================================
# Project : Secure Embedded Linux OTA System (REGA)
# File    : layer.conf
# Author  : Stanley Selvaratnam
# Target  : Toradex Verdin iMX8MP
# Yocto   : Custom layer / recipe
# Email   : stanley.selvaratnam@gmail.com
# ==============================================================================

# Layer configuration for meta-custom-u-boot

LCONF_VERSION = "7"

BBPATH .= ":${LAYERDIR}"

BBFILES += "${LAYERDIR}/recipes-*/*/*.bb \
            ${LAYERDIR}/recipes-*/*/*.bbappend"

BBFILE_COLLECTIONS += "meta-custom-u-boot"
BBFILE_PATTERN_meta-custom-u-boot = "^${LAYERDIR}/"
BBFILE_PRIORITY_meta-custom-u-boot = "99"
LAYERSERIES_COMPAT_meta-custom-u-boot = "scarthgap"
```

## meta-imx8mp-rega/meta-example/conf/layer.conf
```bitbake
# ==============================================================================
# Project : Secure Embedded Linux OTA System (REGA)
# File    : layer.conf
# Author  : Stanley Selvaratnam
# Target  : Toradex Verdin iMX8MP
# Yocto   : Custom layer / recipe
# Email   : stanley.selvaratnam@gmail.com
# ==============================================================================

# We have a conf and classes directory, add to BBPATH
BBPATH .= ":${LAYERDIR}"

# We have recipes-* directories, add to BBFILES
BBFILES += "${LAYERDIR}/recipes-*/*/*.bb \
            ${LAYERDIR}/recipes-*/*/*.bbappend"

BBFILE_COLLECTIONS += "meta-example"
BBFILE_PATTERN_meta-example = "^${LAYERDIR}/"
BBFILE_PRIORITY_meta-example = "6"

LAYERVERSION_meta-example = "1"
LAYERSERIES_COMPAT_meta-example = "kirkstone dunfell nanbield scarthgap"
```

## meta-imx8mp-rega/meta-imx-firmware/conf/layer.conf
```bitbake
# ==============================================================================
# Project : Secure Embedded Linux OTA System (REGA)
# File    : layer.conf
# Author  : Stanley Selvaratnam
# Target  : Toradex Verdin iMX8MP
# Yocto   : Custom layer / recipe
# Email   : stanley.selvaratnam@gmail.com
# ==============================================================================

# meta-imx-firmware configuration

# We have a conf and classes directory, add to BBPATH
BBPATH .= ":${LAYERDIR}"

# This layer is compatible with Yocto releases
LCONF_VERSION = "7"

# Compatibility with the Yocto release
LAYERSERIES_COMPAT_meta-imx-firmware = "scarthgap kirkstone poky"

# Declaration of collection
BBFILE_COLLECTIONS += "meta-imx-firmware"
BBFILE_PATTERN_meta-imx-firmware = "^${LAYERDIR}/"
BBFILE_PRIORITY_meta-imx-firmware = "9"

# Add recipes to BBFILES so BitBake finds our recipes
BBFILES += "${LAYERDIR}/recipes-*/*/*.bb \
            ${LAYERDIR}/recipes-*/*/*.bbappend"
```

## meta-imx8mp-rega/meta-kernel/conf/layer.conf
```bitbake
# ==============================================================================
# Project : Secure Embedded Linux OTA System (REGA)
# File    : layer.conf
# Author  : Stanley Selvaratnam
# Target  : Raspberry Pi 4 Model B 
# Yocto   : Custom layer / recipe
# Email   : stanley.selvaratnam@gmail.com
# ==============================================================================

BBFILE_COLLECTIONS += "meta-kernel"
BBFILE_PATTERN_meta-kernel = "^${LAYERDIR}/"
BBFILE_PRIORITY_meta-kernel = "6"

BBPATH .= ":${LAYERDIR}"

BBFILES += "${LAYERDIR}/recipes-*/*/*.bb \
            ${LAYERDIR}/recipes-*/*/*.bbappend"

# Dependencies on Mender layers
LAYERDEPENDS_meta-kernel = "core mender mender-kernel"

LAYERSERIES_COMPAT_meta-kernel = "scarthgap"
```

## meta-imx8mp-rega/meta-local/conf/layer.conf
```bitbake
# ==============================================================================
# Project : Secure Embedded Linux OTA System (REGA)
# File    : layer.conf
# Author  : Stanley Selvaratnam
# Target  : Toradex Verdin iMX8MP
# Yocto   : Custom layer / recipe
# Email   : stanley.selvaratnam@gmail.com
# ==============================================================================

LCONF_VERSION = "7"

BBFILES += "${LAYERDIR}/recipes-*/*/*/*.bb \
            ${LAYERDIR}/recipes-*/*/*/*.bbappend"

BBFILE_COLLECTIONS += "meta-local"
BBFILE_PATTERN_meta-local = "^${LAYERDIR}/"
BBFILE_PRIORITY_meta-local = "6"

# Specify Yocto versions this layer supports
LAYERSERIES_COMPAT_meta-local = "scarthgap kirkstone"
```

## meta-imx8mp-rega/meta-mender-imx/conf/layer.conf
```bitbake
# ==============================================================================
# Project : Secure Embedded Linux OTA System (REGA)
# File    : layer.conf
# Author  : Stanley Selvaratnam
# Target  : Toradex Verdin iMX8MP
# Yocto   : Custom layer / recipe
# Email   : stanley.selvaratnam@gmail.com
# ==============================================================================

# meta-mender-imx layer configuration

BBFILES += "${LAYERDIR}/recipes-*/*/*.bb \
            ${LAYERDIR}/recipes-*/*/*.bbappend"

# Recipe collection name for this layer
BBFILE_COLLECTIONS += "meta-mender-imx"

# Recipe location pattern for this layer
BBFILE_PATTERN_meta-mender-imx = "^${LAYERDIR}/"

# Layer priority (higher priority overrides others)
BBFILE_PRIORITY_meta-mender-imx = "99"

LAYER_CONF_VERSION = "7"

# List compatible Yocto versions
LAYERSERIES_COMPAT_meta-mender-imx = "scarthgap"
```

## meta-imx8mp-rega/meta-rollback/conf/layer.conf
```bitbake
# ==============================================================================
# Project : Secure Embedded Linux OTA System (REGA)
# File    : layer.conf
# Author  : Stanley Selvaratnam
# Target  : Toradex Verdin iMX8MP
# Yocto   : Custom layer / recipe
# Email   : stanley.selvaratnam@gmail.com
# ==============================================================================

# meta-imx-firmware configuration

# We have a conf and classes directory, add to BBPATH
BBPATH .= ":${LAYERDIR}"

# This layer is compatible with Yocto releases
LCONF_VERSION = "7"

# Compatibility with the Yocto release
LAYERSERIES_COMPAT_meta-rollback= "scarthgap kirkstone poky"

# Declaration of collection
BBFILE_COLLECTIONS += "meta-rollback"
BBFILE_PATTERN_meta-rollback= "^${LAYERDIR}/"
BBFILE_PRIORITY_meta-rollback= "9"

# Add recipes-bsp to BBFILES so BitBake trouve nos recettes
BBFILES += "${LAYERDIR}/recipes-*/*/*.bb \
            ${LAYERDIR}/recipes-*/*/*.bbappend"
```

## meta-imx8mp-rega/meta-wic/conf/layer.conf
```bitbake
# ==============================================================================
# Project : Secure Embedded Linux OTA System (REGA)
# File    : layer.conf
# Author  : Stanley Selvaratnam
# Target  : Toradex Verdin iMX8MP
# Yocto   : Custom layer / recipe
# Email   : stanley.selvaratnam@gmail.com
# ==============================================================================

# We have a conf and classes directory, add to BBPATH
BBPATH .= ":${LAYERDIR}"
BBFILES += "${LAYERDIR}/recipes-*/*/*.bb ${LAYERDIR}/recipes-*/*/*.bbappend"

# Layer priority and compatibility
BBFILE_COLLECTIONS += "meta-wic"
BBFILE_PATTERN_meta-wic := "^${LAYERDIR}/"
BBFILE_PRIORITY_meta-wic = "6"

LAYERVERSION_meta-wic = "1"
LAYERSERIES_COMPAT_meta-wic = "scarthgap kirkstone"
```

## meta-my-layer/meta-connectivity/conf/layer.conf
```bitbake
# meta-my-layer layer configuration

BBPATH .= ":${LAYERDIR}"

LCONF_VERSION = "7"

# Compatibilité avec la série Yocto scarthgap
LAYERSERIES_COMPAT_meta-my-layer = "scarthgap poky"

# Déclaration de la collection
BBFILE_COLLECTIONS += "meta-my-layer"
BBFILE_PATTERN_meta-my-layer = "^${LAYERDIR}/"
BBFILE_PRIORITY_meta-my-layer = "9"

# Recherche des recipes et bbappends dans ce layer
BBFILES += "${LAYERDIR}/recipes-*/*/*.bb \
            ${LAYERDIR}/recipes-*/*/*.bbappend"

# Pour que Yocto trouve les fichiers de patch ou conf associés
FILESEXTRAPATHS:prepend := "${LAYERDIR}/recipes-kernel/linux-firmware-rpidistro/files:"
```

## meta-my-layer/meta-custom-u-boot/conf/layer.conf
```bitbake
# Layer configuration for meta-custom-u-boot

LCONF_VERSION = "7"

BBPATH .= ":${LAYERDIR}"
BBFILES += "${LAYERDIR}/recipes-*/*/*.bb ${LAYERDIR}/recipes-*/*/*.bbappend"

BBFILE_COLLECTIONS += "meta-custom-u-boot"
BBFILE_PATTERN_meta-custom-u-boot = "^${LAYERDIR}/"
BBFILE_PRIORITY_meta-custom-u-boot = "6"
LAYERSERIES_COMPAT_meta-custom-u-boot = "scarthgap"
```

## meta-my-layer/meta-local/conf/layer.conf
```bitbake
# meta-my-layer/meta-local/conf/layer.conf

LCONF_VERSION = "7"

BBFILES += "${LAYERDIR}/recipes-*/*/*/*.bb \
            ${LAYERDIR}/recipes-*/*/*/*.bbappend"

BBFILE_COLLECTIONS += "meta-local"
BBFILE_PATTERN_meta-local = "^${LAYERDIR}/"
BBFILE_PRIORITY_meta-local = "6"

# Indique pour quelles versions de Yocto ce layer est compatible
LAYERSERIES_COMPAT_meta-local = "scarthgap"
```

## meta-my-layer/meta-tdx-image/conf/layer.conf
```bitbake
# We have a conf/layer.conf file
# Minimal layer.conf for meta-local

# Layer metadata
BBPATH .= ":${LAYERDIR}"
BBFILES += "${LAYERDIR}/recipes-*/*/*.bb ${LAYERDIR}/recipes-*/*/*.bbappend"

# Priority
BBFILE_PRIORITY_meta-tdx-image = "6"

# Include classes
LAYERSERIES_COMPAT_meta-tdx-image= "scarthgap"
```
